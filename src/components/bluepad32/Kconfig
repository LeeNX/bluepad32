## src/components/bluepad32/Kconfig
```kconfig
menu "Bluepad32"

    choice BLUEPAD32_PLATFORM
        bool "Target platform"
        default BLUEPAD32_PLATFORM_UNIJOYSTICLE
        help
            Select the Bluepad32 target platform.

        config BLUEPAD32_PLATFORM_AIRLIFT
            bool "AirLift"
            help
                Targets Adafruit devices that have an AirLift co-processor,
                like the Adafruit Metro M4 Express AirLift.

        config BLUEPAD32_PLATFORM_MIGHTYMIGGY
            bool "MightyMiggy"
            help
                Targets MightyMiggy device.

        config BLUEPAD32_PLATFORM_NINA
            bool "NINA"
            depends on SPI_FLASH_USE_LEGACY_IMPL
            help
                Targets Arduino devices that have the NINA co-processor,
                like the Arduino Nano RP2040 Connect.
                Requires "Component config" -> "Spi Flasher Driver" -> "Use the legacy..." to be enabled.

        config BLUEPAD32_PLATFORM_UNIJOYSTICLE
            bool "Unijoysticle"
            help
                Targets Unijoysticle 2 / Unijoysticle 2+ devices.

        config BLUEPAD32_PLATFORM_CUSTOM
            bool "Custom"
            help
                Custom platform, provided by the user/vendor

        config BLUEPAD32_PLATFORM_MAKEFILE
            bool "Decided by Makefile"
            help
                Legacy option. Defined by PLATFORM environment variable.
                Used when compiling Bluepad32 using Makefile.

    endchoice

    config BLUEPAD32_MAX_DEVICES
        int  "Maximum of connected gamepads"
        default 4
        help
        The maximum number of gamepads that can be connected at the same time.

        This limit is defined at compile-time because Bluepad32 tries not to use malloc.
        The higher the number, the more RAM it will take.

    config BLUEPAD32_GAP_SECURITY
        bool "Enable GAP Security"
        default y
        help
            When enabled, it will set GAP Security level to 2.
            This allows Nintendo Switch Pro controller to connect successfully.

            But when enabled, DualShock 3 gamepad fails to connect.

            Only disable it if you want to use DualShock 3 gamepads.

    choice BLUEPAD32_LOG_LEVEL
            bool "Log verbosity"
            default BLUEPAD32_LOG_LEVEL_INFO
            depends on !ESP_CONSOLE_NONE
            help
                Specify how much output to see in logs.

        config BLUEPAD32_LOG_LEVEL_NONE
            bool "No output"
        config BLUEPAD32_LOG_LEVEL_ERROR
            bool "Error"
        config BLUEPAD32_LOG_LEVEL_INFO
            bool "Info"
        config BLUEPAD32_LOG_LEVEL_DEBUG
            bool "Debug"
    endchoice

    config BLUEPAD32_LOG_LEVEL
        int
        default 0 if BLUEPAD32_LOG_LEVEL_NONE
        default 1 if BLUEPAD32_LOG_LEVEL_ERROR
        default 2 if BLUEPAD32_LOG_LEVEL_INFO
        default 3 if BLUEPAD32_LOG_LEVEL_DEBUG

    config BLUEPAD32_USB_CONSOLE_ENABLE
        bool "Enable USB Console"
        default  y
        depends on !ESP_CONSOLE_NONE
        help
            Enables the USB console.
            User can interact with the Bluepad32 firmware via commands.

    config BLUEPAD32_CONSOLE_NVS_COMMAND_ENABLE
        bool "Enable NVS console commands"
        default  n
        depends on BLUEPAD32_USB_CONSOLE_ENABLE
        help
            Enables the NVS console commands. Useful for debugging.

    config BLUEPAD32_ENABLE_BLE_BY_DEFAULT
        bool "Enable BLE by default (beta)"
        depends on BT_ENABLED
        default  y
        help
            Enables Bluetooth Low Energy by default.
            Needed for some mice and gamepads that only work with BLE.
            Can be overriden from the console by using the command "ble_enabled"

    config BLUEPAD32_UNIJOYSTICLE_ENABLE_SWAP_FOR_C64
        bool "Enable Swap Button on Unijoysticle2 C64"
        depends on BLUEPAD32_PLATFORM_UNIJOYSTICLE
        default y
        help
            Enables Swap button in for the Unijoysticle2 C64.
            By enabling it, if the firmware is used in the FlashParty Edition,
            then the Swap button might trigger unexpectedly.
            So, unless you are using FlashParty Edition, leave this feature enabled.

    config BLUEPAD32_BLE_NUS_MAX_CLIENTS
        int "Maximum number of BLE centrals connected to the Nordic UART Service"
        range 1 4
        default 2
        help
        Several BLE centrals (a phone, a PC, a test rig) can be connected to the Nordic UART Service at the same
        time, in addition to the gamepads. Each one needs a BLE connection, so keep
        CONFIG_BTDM_CTRL_BLE_MAX_CONN >= BLUEPAD32_MAX_DEVICES + this value.

        The NuS code runs on the BTstack thread, which is the "main" task. Give it room: keep
        CONFIG_ESP_MAIN_TASK_STACK_SIZE at 6144 or more.

    config BLUEPAD32_BLE_NUS_TX_BUFFER_SIZE
        int "Nordic UART Service TX buffer size, per client"
        range 128 4096
        default 1024
        help
        Bytes that don't fit while a client is slow to receive are dropped.

    menuconfig BLUEPAD32_OTA
        bool "Over-the-air firmware update over the Nordic UART Service"
        default n
        help
        Lets a BLE central update the firmware over NuS, see uni_ota.h. The application needs a partition table with
        two OTA app slots (ota_0 and ota_1) and an otadata partition.

        Enabling this without BLUEPAD32_OTA_ALLOW_AUTH (with a key) or BLUEPAD32_OTA_ALLOW_UNAUTH leaves OTA
        unusable, but still confirms a newly booted image so the bootloader doesn't roll it back.

    if BLUEPAD32_OTA

    config BLUEPAD32_OTA_ALLOW_AUTH
        bool "Allow authenticated OTA (pre-shared key)"
        default y
        help
        The client proves knowledge of BLUEPAD32_OTA_PSK with an HMAC-SHA256 over a device-issued nonce, the image
        size and the image's SHA-256.

    config BLUEPAD32_OTA_PSK
        string "OTA pre-shared key"
        default ""
        depends on BLUEPAD32_OTA_ALLOW_AUTH
        help
        Authenticated OTA is disabled while this is empty. Anyone with the firmware binary can read it, so it only
        keeps out people without access to the image. Use a per-device key, and sign images for real protection.

    config BLUEPAD32_OTA_ALLOW_UNAUTH
        bool "Allow unauthenticated OTA (needs arming)"
        default n
        help
        Any BLE central in range can push firmware while OTA is armed. Arming needs a physical action
        (BLUEPAD32_OTA_BUTTON_GPIO, or the platform calling uni_ota_arm()).

    config BLUEPAD32_OTA_REQUIRE_ARM_FOR_AUTH
        bool "Authenticated OTA also needs arming"
        default y
        help
        Unauthenticated OTA always needs arming. With this set, authenticated OTA does too.

    config BLUEPAD32_OTA_ARM_SECONDS
        int "How long OTA stays armed"
        range 5 3600
        default 120

    config BLUEPAD32_OTA_BUTTON_GPIO
        int "GPIO of the OTA arm button (-1 = none)"
        range -1 48
        default -1
        help
        Hold the button for BLUEPAD32_OTA_BUTTON_HOLD_MS to arm OTA. Platforms without a spare GPIO can call
        uni_ota_arm() instead, e.g. from a gamepad button chord.

    config BLUEPAD32_OTA_BUTTON_ACTIVE_LOW
        bool "OTA arm button is active low"
        default y
        depends on BLUEPAD32_OTA_BUTTON_GPIO >= 0

    config BLUEPAD32_OTA_BUTTON_HOLD_MS
        int "How long to hold the OTA arm button, in ms"
        range 100 10000
        default 1500
        depends on BLUEPAD32_OTA_BUTTON_GPIO >= 0

    config BLUEPAD32_OTA_AUTO_CONFIRM_SEC
        int "Confirm a newly booted image after this many seconds (0 = the application does it)"
        range 0 600
        default 15
        help
        Needs CONFIG_BOOTLOADER_APP_ROLLBACK_ENABLE. If the new image resets before it is confirmed, the bootloader
        goes back to the previous one.

    endif # BLUEPAD32_OTA

    config BLUEPAD32_MAX_ALLOWLIST
        int  "Maximum size of the Bluetooth allowlist"
        default 4
        help
        The maximum of addresses that can be inserted in the Bluetooth allowlist.

        This limit is defined at compile-time because Bluepad32 tries not to use malloc.
        The higher the number, the more RAM it will take.

    config BLUEPAD32_ENABLE_VIRTUAL_DEVICE_BY_DEFAULT
        bool "Enable Virtual Devices by default"
        default n
        help
            A Virtual Device is when a controller like DualSense or DualShock4
            supports also mouse (it is a touchpad, but converted to mouse).
            In this case the "mouse" will represent a virtual device.
            When this happends, Bluepad32 reports that two devices are connected:
            a gamepad and a mouse.
            The "gamepad device" has the "mouse virtual device" as child device.
            When the controller disconnects, or when the "gamepad device"
            is forced to disconnect then both devices will be disconnected.
            Can be overriden from the console by using the command "virtual_device_enabled"

endmenu
```
